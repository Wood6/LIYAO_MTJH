ENTRY(mymain)

SECTIONS
{
	.text 0x8048400 :
	{
		*(.text)
	}
	
	. = 0x804a700;       /* .data段内地址 */ 
	S1 = .;              /* 将S1重定位到地址 0x804a700 地址上，就是变量的本质，变量名是一个内存地址的别名 */
					     /* 不要理解为将 0x804a700地址赋值给S1，这样是错误的理解方式 */
	. += 4;
	S2 = .;

	.data 0x804a800 :
	{
		*(.data)
	}
	
	.bss :
	{
		*(.bss)
	}
}

